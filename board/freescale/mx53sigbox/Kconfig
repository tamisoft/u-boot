## board/freescale/mx53sigbox/Kconfig
```kconfig
if TARGET_MX53SIGBOX

config SYS_BOARD
	default "mx53sigbox"

config SYS_VENDOR
	default "freescale"

config SYS_SOC
	default "mx5"

config SYS_CONFIG_NAME
	default "mx53sigbox"

endif
```

## configs/mx53sigbox_defconfig
```kconfig
CONFIG_SYS_EXTRA_OPTIONS="IMX_CONFIG=board/freescale/mx53sigbox/imximage.cfg"
CONFIG_ARM=y
CONFIG_TARGET_MX53SIGBOX=y
```
